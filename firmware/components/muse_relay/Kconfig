## firmware/components/muse_relay/Kconfig
```kconfig
menu "Muse Relay"
    config MUSE_RELAY_ATOMS3_LITE_LED
        bool "Drive the built-in RGB LED on the AtomS3 Lite"
        depends on IDF_TARGET_ESP32S3 && HOMEHUB_LED_BACKEND_NONE && !SPIRAM && !ESPTOOLPY_OCT_FLASH
        default n
        help
            Enable the Muse Relay network and request indicator on GPIO35.
            Select this for the AtomS3 Lite (C124) with the WS2812C-2020 pixel.

    config MUSE_RELAY_COMPACT_NOISE
        bool "Use bounded Noise buffers for a headless relay"
        depends on !MUSE_ENABLED && !SPIRAM && !HOMEHUB_TUNNEL
        default n
        help
            Receive standard 16 KiB chat frames with 17 KiB inbound scratch.
            Smaller outbound buffers retain internal RAM for the HTTPS relay.

    config MUSE_RELAY_ALLOW_HTTP
        bool "Allow plain HTTP on a trusted private test network"
        default n
        help
            Keep disabled for normal use. HTTPS validates the server certificate.
            Enable only for a temporary local integration test without real secrets.
endmenu
```
